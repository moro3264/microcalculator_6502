;   ADRESE ACIA
.define ACIA_DATA_REG       $8000
.define ACIA_STATUS_REG     $8001
.define ACIA_COMMAND_REG    $8002
.define ACIA_CONTROL_REG    $8003

;   ADRESE VIA
.define VIA_PORTB           $8010
.define VIA_PORTA           $8011
.define VIA_DDRB            $8012
.define VIA_DDRA            $8013
.define VIA_T1CL            $8014
.define VIA_T1CH            $8015
.define VIA_T1LL            $8016
.define VIA_T1LH            $8017
.define VIA_T2CL            $8018
.define VIA_T2CH            $8019
.define VIA_SR              $801A
.define VIA_ACR             $801B
.define VIA_PCR             $801C
.define VIA_IFR             $801D
.define VIA_IER             $801E
.define VIA_PORTA_NH        $801F

